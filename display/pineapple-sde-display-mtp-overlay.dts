/dts-v1/;
/plugin/;

#include "pineapple-sde-display-mtp.dtsi"

/ {
	model = "Qualcomm Technologies, Inc. Pineapple MTP";
	compatible = "qcom,pineapple-mtp", "qcom,pineapple", "qcom,mtp";
	qcom,board-id = <0x8 0>;
};

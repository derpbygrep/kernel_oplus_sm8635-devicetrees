/dts-v1/;
/plugin/;

#include "pineapple-sde-display-qrd.dtsi"

/ {
	model = "Qualcomm Technologies, Inc. Pineapple QRD";
	compatible = "qcom,pineapple-qrd", "qcom,pineapple", "qcom,qrd";
	qcom,board-id = <0xB 0>;
};

/dts-v1/;
/plugin/;

#include "pineapple-sde-display-rumi.dtsi"

/ {
	model = "Qualcomm Technologies, Inc. Pineapple RUMI";
	compatible = "qcom,pineapple-rumi", "qcom,pineapple", "qcom,rumi";
	qcom,board-id = <15 0>;
};

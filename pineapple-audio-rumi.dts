/dts-v1/;
/plugin/;

#include "pineapple-audio-rumi.dtsi"
 / {
	model = "Qualcomm Technologies, Inc. Pineapple RUMI";
	compatible = "qcom,pineapple-rumi", "qcom,pineapple", "qcom,rumi";
	qcom,msm-id = <557 0x10000>;
	qcom,board-id = <0x1000F 0>;
};
